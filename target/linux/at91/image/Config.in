## target/linux/at91/image/Config.in
```kconfig
config AT91_DFBOOT
	bool "Build dataflashboot loader"
	depends on TARGET_at91
	default n

config FLEXIBITY_ROOT
	bool "Build Flexibity RootFS (with embedded kernel)"
	depends on TARGET_at91_flexibity
	default n

config LORIX_ONE_SERIAL
    depends on (TARGET_at91_lorix_one || TARGET_at91_lorix_one512 || TARGET_at91_wifx_l1)
    bool "Getty for serial port"
    default y
    select PACKAGE_busybox
    select BUSYBOX_CUSTOM
    select BUSYBOX_CONFIG_GETTY
```
